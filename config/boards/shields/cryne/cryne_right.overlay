#include "cryne.dtsi"

&cryne_transform {
  col-offset = <5>;
};

&split_peripheral {
  status = "okay";
};

&kscan0 {
  row-gpios
    = <&gpio0 6 (GPIO_ACTIVE_HIGH | GPIO_PULL_DOWN)>    // ROW0 = 006
    , <&gpio0 22 (GPIO_ACTIVE_HIGH | GPIO_PULL_DOWN)>   // ROW1 = 022
    , <&gpio1 0 (GPIO_ACTIVE_HIGH | GPIO_PULL_DOWN)>    // ROW2 = 100
    , <&gpio1 6 (GPIO_ACTIVE_HIGH | GPIO_PULL_DOWN)>    // ROW3 = 106
    ;

  col-gpios
    = <&gpio0 20 GPIO_ACTIVE_HIGH>    // COL5 (H) = 020
    , <&gpio0 8 GPIO_ACTIVE_HIGH>     // COL6 (J) = 008
    , <&gpio0 17 GPIO_ACTIVE_HIGH>    // COL7 (K) = 017
    , <&gpio0 24 GPIO_ACTIVE_HIGH>    // COL8 (L) = 024
    , <&gpio1 4 GPIO_ACTIVE_HIGH>     // COL9 (;) = 104
    ;
};
