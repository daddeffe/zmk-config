## boards/shields/cryne/Kconfig.defconfig
```kconfig
if SHIELD_CRYNE_LEFT

config ZMK_KEYBOARD_NAME
    default "Cryne Left"

endif

if SHIELD_CRYNE_RIGHT

config ZMK_KEYBOARD_NAME
    default "Cryne Right"

endif

# Note: ZMK_SPLIT defaults removed - configure in .conf files
```

## boards/shields/cryne/Kconfig.shield
```kconfig
config SHIELD_CRYNE_LEFT
    def_bool $(shields_list_contains,cryne_left)

config SHIELD_CRYNE_RIGHT
    def_bool $(shields_list_contains,cryne_right)

config SHIELD_CRYNE
    def_bool $(shields_list_contains,cryne_left) || $(shields_list_contains,cryne_right)
    select ZMK_SPLIT
```

## config/boards/shields/cryne/Kconfig.shield
```kconfig
config SHIELD_CRYNE_LEFT
    def_bool $(shields_list_contains,cryne_left)

config SHIELD_CRYNE_RIGHT
    def_bool $(shields_list_contains,cryne_right)
```
