#include "cryne.dtsi"

&cryne_transform {
  col-offset = <0>;
};

&split_central {
  status = "okay";
};

&kscan0 {
  row-gpios
    = <&gpio0 8 (GPIO_ACTIVE_HIGH | GPIO_PULL_DOWN)>   // ROW0 = 008
    , <&gpio0 22 (GPIO_ACTIVE_HIGH | GPIO_PULL_DOWN)>  // ROW1 = 022
    , <&gpio1 0 (GPIO_ACTIVE_HIGH | GPIO_PULL_DOWN)>   // ROW2 = 100
    , <&gpio1 6 (GPIO_ACTIVE_HIGH | GPIO_PULL_DOWN)>   // ROW3 = 106
    ;

  col-gpios
    = <&gpio0 17 GPIO_ACTIVE_HIGH>   // COL0 (A) = 017
    , <&gpio0 24 GPIO_ACTIVE_HIGH>   // COL1 (S) = 024
    , <&gpio0 20 GPIO_ACTIVE_HIGH>   // COL2 (D) = 020
    , <&gpio1 4 GPIO_ACTIVE_HIGH>    // COL3 (F) = 104
    , <&gpio0 6 GPIO_ACTIVE_HIGH>    // COL4 (G) = 006
    ;
};
